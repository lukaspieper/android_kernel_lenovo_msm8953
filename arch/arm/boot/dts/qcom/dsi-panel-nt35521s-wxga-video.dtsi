/* Copyright (c) 2013, The Linux Foundation. All rights reserved.
 *
 * This program is free software; you can redistribute it and/or modify
 * it under the terms of the GNU General Public License version 2 and
 * only version 2 as published by the Free Software Foundation.
 *
 * This program is distributed in the hope that it will be useful,
 * but WITHOUT ANY WARRANTY; without even the implied warranty of
 * MERCHANTABILITY or FITNESS FOR A PARTICULAR PURPOSE.  See the
 * GNU General Public License for more details.
 */

/*---------------------------------------------------------------------------
 * This file is autogenerated file using gcdb parser. Please do not edit it.
 * Update input XML file to add a new entry or update variable in this file
 * VERSION = "1.0"
 *---------------------------------------------------------------------------*/
&mdss_mdp {
	dsi_nt35521s_wxga_video: qcom,mdss_dsi_nt35521s_wxga_video {
		qcom,mdss-dsi-panel-name = "nt35521s wxga video mode dsi panel";
		qcom,mdss-dsi-panel-controller = <&mdss_dsi0>;
		qcom,mdss-dsi-panel-type = "dsi_video_mode";
		qcom,mdss-dsi-panel-destination = "display_1";
		qcom,mdss-dsi-panel-framerate = <60>;
		qcom,mdss-dsi-virtual-channel-id = <0>;
		qcom,mdss-dsi-stream = <0>;
		qcom,mdss-dsi-panel-width = <800>;
		qcom,mdss-dsi-panel-height = <1280>;
		qcom,mdss-dsi-h-front-porch = <80>;
		qcom,mdss-dsi-h-back-porch = <80>;
		qcom,mdss-dsi-h-pulse-width = <4>;
		qcom,mdss-dsi-h-sync-skew = <0>;
		qcom,mdss-dsi-v-back-porch = <16>;
		qcom,mdss-dsi-v-front-porch = <20>;
		qcom,mdss-dsi-v-pulse-width = <4>;
		qcom,mdss-dsi-h-left-border = <0>;
		qcom,mdss-dsi-h-right-border = <0>;
		qcom,mdss-dsi-v-top-border = <0>;
		qcom,mdss-dsi-v-bottom-border = <0>;
		qcom,mdss-dsi-bpp = <24>;
		qcom,mdss-dsi-color-order = "rgb_swap_rgb";
		qcom,mdss-dsi-underflow-color = <0xff>;
		qcom,mdss-dsi-border-color = <0>;
		qcom,mdss-dsi-pixel-packing = "tight";
		qcom,mdss-dsi-pixel-alignment = <0>;
		qcom,mdss-dsi-on-command = [29 01 00 00 00 00 06 F0 55 AA 52 08 00 
			29 01 00 00 00 00 03 B1 68 01 
			29 01 00 00 00 00 02 B6 08 
			29 01 00 00 00 00 02 6F 02 
			29 01 00 00 00 00 02 B8 08 
			29 01 00 00 00 00 03 BB 54 44 
			29 01 00 00 00 00 03 BC 05 05 
			29 01 00 00 00 00 02 C7 01 
			29 01 00 00 00 00 06 BD 02 B0 1E 1E 00 
			29 01 00 00 00 00 03 C5 01 07 
			29 01 00 00 00 00 02 C8 83 
			29 01 00 00 00 00 06 F0 55 AA 52 08 01 
			29 01 00 00 00 00 03 B0 05 05 
			29 01 00 00 00 00 03 B1 05 05 
			29 01 00 00 00 00 03 BC 90 01 
			29 01 00 00 00 00 03 BD 90 01 
			29 01 00 00 00 00 02 CA 00 
			29 01 00 00 00 00 02 C0 04 
			29 01 00 00 00 00 03 B3 28 28 
			29 01 00 00 00 00 03 B4 12 12 
			29 01 00 00 00 00 03 B9 45 45 
			29 01 00 00 00 00 03 BA 14 14 
			29 01 00 00 00 00 06 F0 55 AA 52 08 02 
			29 01 00 00 00 00 02 EE 01 
			29 01 00 00 00 00 05 EF 09 06 15 18 
			29 01 00 00 00 00 07 B0 00 00 00 0F 00 28 
			29 01 00 00 00 00 02 6F 06 
			29 01 00 00 00 00 07 B0 00 47 00 58 00 76 
			29 01 00 00 00 00 02 6F 0C 
			29 01 00 00 00 00 05 B0 00 9B 00 CD 
			29 01 00 00 00 00 07 B1 00 FC 01 3E 01 7C 
			29 01 00 00 00 00 02 6F 06 
			29 01 00 00 00 00 07 B1 01 D3 02 1A 02 1C 
			29 01 00 00 00 00 02 6F 0C 
			29 01 00 00 00 00 05 B1 02 5F 02 BF 
			29 01 00 00 00 00 07 B2 02 F6 03 34 03 57 
			29 01 00 00 00 00 02 6F 06 
			29 01 00 00 00 00 07 B2 03 86 03 8F 03 AC 
			29 01 00 00 00 00 02 6F 0C 
			29 01 00 00 00 00 05 B2 03 BD 03 E4 
			29 01 00 00 00 00 05 B3 03 F7 03 FF 
			29 01 00 00 00 00 06 F0 55 AA 52 08 06 
			29 01 00 00 00 00 03 B0 0B 2E 
			29 01 00 00 00 00 03 B1 2E 2E 
			29 01 00 00 00 00 03 B2 2E 09 
			29 01 00 00 00 00 03 B3 2A 29 
			29 01 00 00 00 00 03 B4 1B 19 
			29 01 00 00 00 00 03 B5 17 15 
			29 01 00 00 00 00 03 B6 13 11 
			29 01 00 00 00 00 03 B7 01 2E 
			29 01 00 00 00 00 03 B8 2E 2E 
			29 01 00 00 00 00 03 B9 2E 2E 
			29 01 00 00 00 00 03 BA 2E 2E 
			29 01 00 00 00 00 03 BB 2E 2E 
			29 01 00 00 00 00 03 BC 2E 00 
			29 01 00 00 00 00 03 BD 10 12 
			29 01 00 00 00 00 03 BE 14 16 
			29 01 00 00 00 00 03 BF 18 1A 
			29 01 00 00 00 00 03 C0 29 2A 
			29 01 00 00 00 00 03 C1 08 2E 
			29 01 00 00 00 00 03 C2 2E 2E 
			29 01 00 00 00 00 03 C3 2E 0A 
			29 01 00 00 00 00 03 E5 2E 2E 
			29 01 00 00 00 00 03 C4 0A 2E 
			29 01 00 00 00 00 03 C5 2E 2E 
			29 01 00 00 00 00 03 C6 2E 00 
			29 01 00 00 00 00 03 C7 2A 29 
			29 01 00 00 00 00 03 C8 10 12 
			29 01 00 00 00 00 03 C9 14 16 
			29 01 00 00 00 00 03 CA 18 1A 
			29 01 00 00 00 00 03 CB 08 2E 
			29 01 00 00 00 00 03 CC 2E 2E 
			29 01 00 00 00 00 03 CD 2E 2E 
			29 01 00 00 00 00 03 CE 2E 2E 
			29 01 00 00 00 00 03 CF 2E 2E 
			29 01 00 00 00 00 03 D0 2E 09 
			29 01 00 00 00 00 03 D1 1B 19 
			29 01 00 00 00 00 03 D2 17 15 
			29 01 00 00 00 00 03 D3 13 11 
			29 01 00 00 00 00 03 D4 29 2A 
			29 01 00 00 00 00 03 D5 01 2E 
			29 01 00 00 00 00 03 D6 2E 2E 
			29 01 00 00 00 00 03 D7 2E 0B 
			29 01 00 00 00 00 03 E6 2E 2E 
			29 01 00 00 00 00 06 D8 00 00 00 00 00 
			29 01 00 00 00 00 06 D9 00 00 00 00 00 
			29 01 00 00 00 00 02 E7 00 
			29 01 00 00 00 00 06 F0 55 AA 52 08 03 
			29 01 00 00 00 00 03 B0 20 00 
			29 01 00 00 00 00 03 B1 20 00 
			29 01 00 00 00 00 06 B2 05 00 00 00 00 
			29 01 00 00 00 00 06 B6 05 00 00 00 00 
			29 01 00 00 00 00 06 B7 05 00 00 00 00 
			29 01 00 00 00 00 06 BA 57 00 00 00 00 
			29 01 00 00 00 00 06 BB 57 00 00 00 00 
			29 01 00 00 00 00 05 C0 00 00 00 00 
			29 01 00 00 00 00 05 C1 00 00 00 00 
			29 01 00 00 00 00 02 C4 60 
			29 01 00 00 00 00 02 C5 40 
			29 01 00 00 00 00 06 F0 55 AA 52 08 05 
			29 01 00 00 00 00 06 BD 03 01 03 03 03 
			29 01 00 00 00 00 03 B0 17 06 
			29 01 00 00 00 00 03 B1 17 06 
			29 01 00 00 00 00 03 B2 17 06 
			29 01 00 00 00 00 03 B3 17 06 
			29 01 00 00 00 00 03 B4 17 06 
			29 01 00 00 00 00 03 B5 17 06 
			29 01 00 00 00 00 02 B8 00 
			29 01 00 00 00 00 02 B9 00 
			29 01 00 00 00 00 02 BA 00 
			29 01 00 00 00 00 02 BB 02 
			29 01 00 00 00 00 02 BC 00 
			29 01 00 00 00 00 02 C0 07 
			29 01 00 00 00 00 02 C4 80 
			29 01 00 00 00 00 02 C5 A4 
			29 01 00 00 00 00 03 C8 05 30 
			29 01 00 00 00 00 03 C9 01 31 
			29 01 00 00 00 00 04 CC 00 00 3C 
			29 01 00 00 00 00 04 CD 00 00 3C 
			29 01 00 00 00 00 06 D1 00 05 09 07 10 
			29 01 00 00 00 00 06 D2 00 05 0E 07 10 
			29 01 00 00 00 00 02 E5 06 
			29 01 00 00 00 00 02 E6 06 
			29 01 00 00 00 00 02 E7 06 
			29 01 00 00 00 00 02 E8 06 
			29 01 00 00 00 00 02 E9 06 
			29 01 00 00 00 00 02 EA 06 
			29 01 00 00 00 00 02 ED 30 
			29 01 00 00 00 00 02 6F 11 
			29 01 00 00 00 00 02 F3 01 
			29 01 00 00 00 00 02 51 FF 
			29 01 00 00 00 00 02 53 2C 
			29 01 00 00 00 00 02 35 00 
			05 01 00 00 78 00 02 11 00 
			05 01 00 00 14 00 02 29 00];
		qcom,mdss-dsi-off-command = [05 01 00 00 32 00 02 28 00
					05 01 00 00 78 00 02 10 00];
		qcom,mdss-dsi-on-command-state = "dsi_lp_mode";
		qcom,mdss-dsi-off-command-state = "dsi_hs_mode";
		qcom,mdss-dsi-h-sync-pulse = <1>;
		qcom,mdss-dsi-traffic-mode = "burst_mode";
		qcom,mdss-dsi-lane-map = "lane_map_0123";
		qcom,mdss-dsi-bllp-eof-power-mode;
		qcom,mdss-dsi-bllp-power-mode;
		qcom,mdss-dsi-lane-0-state;
		qcom,mdss-dsi-lane-1-state;
		qcom,mdss-dsi-lane-2-state;
		qcom,mdss-dsi-lane-3-state;
		qcom,mdss-dsi-panel-timings = [87 1C 12 00 42 44 18 20 17 03 04 00];
		qcom,mdss-dsi-t-clk-post = <0x04>;
		qcom,mdss-dsi-t-clk-pre = <0x1b>;
		qcom,mdss-dsi-bl-min-level = <1>;
		qcom,mdss-dsi-bl-max-level = <4095>;
		qcom,mdss-dsi-dma-trigger = "trigger_sw";
		qcom,mdss-dsi-mdp-trigger = "none";
		qcom,mdss-dsi-bl-pmic-control-type = "bl_ctrl_wled";
		qcom,mdss-dsi-reset-sequence = <1 20>, <0 2>, <1 20>;
	};
};
