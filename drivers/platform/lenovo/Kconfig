## drivers/platform/lenovo/Kconfig
```kconfig
# Lenovo configuration options

config MACH_LENOVO_MSM8953
	bool "Lenovo MSM8953"
	depends on ARCH_MSM8953
	help
	  Support for MSM8953 Lenovo variants

menu "Lenovo board selection"

config MACH_LENOVO_KUNTAO
	bool "Kuntao board"
	select MACH_LENOVO_MSM8953
	help
	  Support for Lenovo P2 (kuntao)

config MACH_LENOVO_TBX704
	bool "TBX704 board"
	select MACH_LENOVO_MSM8953
	help
	  Support for Lenovo Tab 4 10 Plus (TBX704)

endmenu
```
